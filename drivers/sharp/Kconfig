## drivers/sharp/Kconfig
```kconfig
#
# SHARP configuration
#

menu "SHARP Device Drivers"

source "drivers/sharp/proximity_light/Kconfig"

endmenu
```

## drivers/soc/qcom/sharp/Kconfig
```kconfig
#
# SHARP configuration
#

menu "SHARP Device Drivers for Qualcomm SOC"

endmenu
```

## drivers/soc/qcom/sharp/shboot/Kconfig
```kconfig
# drivers/soc/qcom/sharp/shboot/Kconfig

menu "Sharp Boot Driver"

config SHARP_BOOT
	bool "SHARP BOOT DRIVER"
	depends on SHARP_SMEM_CUST
	default n

endmenu
```

## drivers/soc/qcom/sharp/shdiag/Kconfig
```kconfig
# drivers/soc/qcom/sharp/shdiag/Kconfig

menu "SHARP SHDIAG SMEM driver"

config SHARP_SHDIAG_SMD
	tristate "SHARP SHDIAG SMEM DRIVER"
	depends on SHARP_SMEM_CUST
	default n

endmenu
```

## drivers/soc/qcom/sharp/shrlog/Kconfig
```kconfig
# drivers/soc/qcom/sharp/shrlog/Kconfig

menu "SHARP SHLOG"

config SHARP_SHLOG
	tristate "SHARP SHLOG driver base system."
	default n
	help
	  SHARP SHLOG driver base system.

config SHARP_SHLOG_RAMOOPS
	bool "Enable SHARP SHLOG for ramoops."
	depends on SHARP_SHLOG
	default n
	help
	  Enable SHARP SHLOG for ramoops.

config SHARP_SHLOG_TASKLIST
	bool "Enable SHARP SHLOG for tasks."
	depends on SHARP_SHLOG
	default n
	help
	  Enable SHARP SHLOG for tasks.

config SHARP_SHLOG_LATESTSTACK
	bool "Enable SHARP SHLOG for tasks of latest process."
	depends on SHARP_SHLOG
	default n
	help
	  Enable SHARP SHLOG for tasks of latest process.

config SHARP_HANDLE_PANIC
	bool "Enable SHARP handler for panic."
	depends on SHARP_SHLOG
	default n
	help
	  Enable SHARP handler for panic.

config SHARP_HANDLE_DLOAD
	bool "Enable SHARP handler for dload."
	depends on SHARP_SHLOG
	default n
	help
	  Enable SHARP handler for dload.

config SHARP_HANDLE_DLOAD_MINIDEFAULT
	bool "Set default of dload to mini."
	depends on SHARP_HANDLE_DLOAD
	default n
	help
	  Enable Set default of dload to mini.

config SHARP_HANDLE_SURFACE_FLINGER
	bool "Enable SHARP handler for reset of surfaceflinger."
	depends on SHARP_SHLOG
	default n
	help
	  Enable SHARP handler for reset of surfaceflinger.

config SHARP_PANIC_ON_PWRKEY
	bool "Enable SHARP handler to call panic when powerkey pressed."
	depends on SHARP_SHLOG
	default n
	help
	  Enable SHARP handler to call panic when powerkey pressed.

config SHARP_PANIC_ON_PWRKEY_TIMEOUT
	int "Timeout to call panic when power-key is pressed."
	depends on SHARP_SHLOG
	default 4
	help
	  Timeout to call panic when power-key is pressed.

config SHARP_PANIC_ON_PWRKEY_TIMEOUT_VS
	int "Timeout to call panic when power-key is pressed."
	depends on SHARP_SHLOG
	default 4
	help
	  Timeout to call panic when power-key is pressed (S).

config SHARP_PANIC_ON_PWRKEY_TIMEOUT_MS
	int "Timeout to call panic when power-key is pressed, mseconds part"
	depends on SHARP_SHLOG
	default 0
	help
	  Timeout to call panic when power-key is pressed, mseconds part.

config SHARP_PANIC_ON_PWRKEY_TIMEOUT_MS_VS
	int "Timeout to call panic when power-key is pressed, mseconds part"
	depends on SHARP_SHLOG
	default 0
	help
	  Timeout to call panic when power-key is pressed, mseconds part (S).

config SHARP_SHLOG_SHOW_ABOOTLOG
	bool "Enable dumping aboot-log after boot."
	depends on SHARP_SHLOG
	default n
	help
	  Enable dumping aboot-log after boot.

config SHARP_SUPPORT_DLOAD_BOOTPARAM
	bool "Add parameter to set initial value for dload."
	default n
	help
	  Add parameter to set initial value for dload.

endmenu
```

## drivers/soc/qcom/sharp/shtimer/Kconfig
```kconfig
# drivers/soc/qcom/sharp/shtimer/Kconfig

menu "SHTIMER"

config SHARP_SHTIMER
	bool "SHARP Timer"
	default n

endmenu
```
